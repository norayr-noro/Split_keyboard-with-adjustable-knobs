## zmk-config/config/boards/shields/splitmk/Kconfig.defconfig
```kconfig
if SHIELD_SPLITMK_LEFT || SHIELD_SPLITMK_RIGHT

config ZMK_KEYBOARD_NAME
    default "SplitMK"

config ZMK_SPLIT
    default y

config ZMK_SPLIT_BLE
    default y

# Left side is the central (connects to PC via BLE)
config ZMK_SPLIT_BLE_ROLE_CENTRAL
    default y if SHIELD_SPLITMK_LEFT

config ZMK_SPLIT_BLE_ROLE_PERIPHERAL
    default y if SHIELD_SPLITMK_RIGHT

# Enable encoder support
config EC11
    default y

config EC11_TRIGGER_GLOBAL_THREAD
    default y

# Battery reporting (if you add a LiPo to each side)
config ZMK_BATTERY_REPORTING
    default y

endif
```

## zmk-config/config/boards/shields/splitmk/Kconfig.shield
```kconfig
config SHIELD_SPLITMK_LEFT
    def_bool $(shields_list_contains,splitmk_left)

config SHIELD_SPLITMK_RIGHT
    def_bool $(shields_list_contains,splitmk_right)
```

## zmk-config/config/west.yml
```yaml
manifest:
  remotes:
    - name: zmkfirmware
      url-base: https://github.com/zmkfirmware
    - name: pico-zmk
      url-base: https://github.com/adilnurimanov
  projects:
    - name: zmk
      remote: zmkfirmware
      revision: main
      import: app/west.yml
  self:
    path: config
```
